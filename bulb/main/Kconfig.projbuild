## bulb/main/Kconfig.projbuild
```kconfig
menu "c6 bulb (Zigbee end device)"

config C6_ZB_CHANNEL_MASK
    hex "Channels it may scan and join"
    default 0x07FFF800
    help
        Bit n = channel n. The default is every channel, 11-26 (0x07FFF800, 0.5.0): a Zigbee controller may run
        on any of them. Both the primary and the secondary channel set are this mask. A board that
        has a network rejoins on its stored channel without scanning. What keeps a board off
        another network is the ext_pan setting (PUT /api/v1/settings), not this mask.

config C6_ZB_RX_WATCHDOG_S
    int "Default for the rx_wd_s setting: reboot after this many seconds without receiving anything"
    default 0
    help
        Used only while the rx_wd_s setting is not stored (GET/PUT /api/v1/settings, 0.4.0); the
        setting is 0 (off) or 30-3600 and is read on every watchdog pass. The Zigbee controller acknowledges the
        On/Off report every 20 s. Armed only after the first frame since boot; doubles with each
        consecutive stall reboot, back to the setting after 30 healthy minutes. 0 = off, the default:
        a board whose group the Zigbee controller never acknowledges would reboot for nothing.

config C6_ZB_EXT_PANID
    string "Only join this extended PAN ID (16 hex, MSB first); empty = any"
    default ""
    help
        The default for the ext_pan setting (0.5.0); empty in a public build. Used only while the
        setting is not stored; a stored empty ext_pan joins any network. Read when the stack starts,
        so a change takes effect at the next reboot or POST /api/v1/zigbee/erase.

config C6_ZB_INSTALL_CODE
    string "128-bit install code + CRC, 36 hex digits; empty = join on the default TC link key"
    default ""

choice C6_ZB_PROFILE
    prompt "What the bulb presents"
    default C6_ZB_PROFILE_ESPRESSIF

config C6_ZB_PROFILE_ESPRESSIF
    bool "Espressif ZHA colour dimmable light, identity strings from below"

config C6_ZB_PROFILE_SENGLED_E11
    bool "Sengled E11-N1EA clone (colour, HA 1.2), every value read off the real bulb"

endchoice

config C6_ZB_E11_DEVICE_ID
    hex "E11 profile: endpoint device id"
    depends on C6_ZB_PROFILE_SENGLED_E11
    default 0x0102
    help
        0x0102 Color Dimmable Light is what the real E11-N1EA says. 0x0101 Dimmable Light is
        what the Z01-A19NAE26 and the E21-N13A say. Changing it is an experiment: which of the
        two the tested Zigbee controller's multicolor flag follows.

config C6_ZB_REPORT_LEVEL_CT
    int "Also send the Zigbee controller unsolicited Level and CT reports after POST /zb/light (1 = on)"
    default 0
    help
        The tested Zigbee controller ignores them for its LIGHT_STS, and once flipped a group OFF after a CT report.
        Kept for experiments.

config C6_ZB_REPORT_DST_EP
    int "Endpoint on the Zigbee controller's coordinator that the experimental Level/CT reports go to"
    range 1 240
    default 2
    help
        Only used with C6_ZB_REPORT_LEVEL_CT. 1 until 0.3.23; the boards' On/Off bindings point at
        endpoint 2 since they were re-paired.

config C6_ZB_IEEE
    string "IEEE address override (16 hex, MSB first); empty = the chip's own, or derived from the MAC (E11)"
    default ""
    help
        Empty, Espressif profile (0.7.0): the chip's own IEEE 802.15.4 address (ESP_MAC_IEEE802154,
        the base MAC's first three bytes, FF FE, then its last three). Empty, E11 profile (0.4.0):
        B0CE18C600 followed by the last three bytes of the chip's base MAC: a base MAC of
        AA:BB:CC:11:22:33 gives B0CE18C600112233 (the Espressif profile would give AABBCCFFFE112233).
        Set it only to override; never change the address a paired board uses.

config C6_ZB_ENDPOINT
    int "Light endpoint"
    default 1

config C6_ZB_MANUFACTURER
    string "Basic cluster ManufacturerName"
    default "Zigbee Anthema"
    help
        At most 32 characters (a ZCL string); more stops the build.

config C6_ZB_MODEL
    string "Basic cluster ModelIdentifier"
    default "zigbee-anthema"
    help
        At most 32 characters (a ZCL string); more stops the build.

config C6_ZB_MANUF_CODE
    hex "Node descriptor manufacturer code"
    default 0x131B
    help
        0x131B is Espressif's. Sengled's is 0x1160 (the clone in the Zigbee controller trial).

config C6_ZB_KEY_ENDPOINT
    bool "GET /zb/key: the network key, for decrypting a sniffer's captures (token)"
    default n
    help
        Serves the network key to the holder of the token, for reading a sniffer's captures of the
        network. Off by default: turn it on only on a bench board.

endmenu
```

## components/c6_base/Kconfig
```kconfig
menu "c6 base (Wi-Fi, OTA, logs, claim)"

config C6_WIFI_SSID
    string "Wi-Fi SSID"
    default ""
    help
        Used once, when nothing is stored (0.5.0); empty in a public build.
        Leave empty in a public build; set it in your own sdkconfig.

config C6_WIFI_PASS
    string "Wi-Fi password"
    default ""
    help
        Used once, when nothing is stored (0.5.0); empty in a public build.
        Leave empty in a public build; set it in your own sdkconfig.

config C6_OTA_TOKEN
    string "Developer credential (X-OTA-Token)"
    default ""
    help
        The developer credential, also accepted by the claim-protected endpoints while set;
        empty in a public build. 16 to 79 characters, or every X-OTA-Token value is refused
        (more than 79 stops the build).
        Leave empty in a public build; set it in your own sdkconfig.

config C6_LED_GPIO
    int "Blue LED GPIO (held off)"
    default 7
    help
        The M5Stack NanoC6's blue LED. It is configured as an output and held off; every LED
        pattern is on the colour LED (C6_RGB_GPIO).

config C6_RGB_GPIO
    int "Colour LED (WS2812) data GPIO"
    default 20
    help
        The data line of the M5Stack NanoC6's colour LED, a WS2812 driven through the RMT.
        It shows the button's hold cues, the setup hotspot, an unclaimed board and /identify.

config C6_RGB_PWR_GPIO
    int "Colour LED power GPIO"
    default 19
    help
        The GPIO that switches the colour LED's power on the M5Stack NanoC6. Driven high at
        start.

config C6_RGB_LEVEL
    int "Colour LED brightness (0-255)"
    range 0 255
    default 40
    help
        Every colour the colour LED shows, the one /identify is given included, is scaled by
        this over 255. 0 keeps the LED dark.

config C6_BUTTON_GPIO
    int "Button GPIO (active low)"
    default 9
    help
        The M5Stack NanoC6's button. A press opens the claim window for 10 minutes, a 3-9 s hold
        opens the setup hotspot for 10 minutes, a 10 s hold clears the claim.

config C6_AP_SSID_PREFIX
    string "Setup hotspot SSID prefix"
    default "Zigbee-Anthema-"
    help
        The hotspot's SSID is this followed by the board's six-hex serial.

config C6_WIFI_FAIL_S
    int "Seconds without an IP before the hotspot opens"
    default 60
    help
        Seconds without an IP before the hotspot opens, counted from boot and from every new
        Wi-Fi setting.

config C6_VERIFY_TIMEOUT_S
    int "Seconds a new OTA image has to bring up Wi-Fi and HTTP before it is rolled back"
    default 120

config C6_WIFI_START_DELAY_MS
    int "Delay before Wi-Fi starts (diagnostic; 0 = at once)"
    default 0
    help
        Keep it well under C6_VERIFY_TIMEOUT_S, or a new image rolls back before Wi-Fi is up.

config C6_VERIFY_STABLE_S
    int "Seconds a new OTA image must then run without a reset before it is marked valid"
    default 60

config C6_VERIFY_ZIGBEE_S
    int "Seconds from boot a new OTA image has to get Zigbee back before it is rolled back"
    default 600
    help
        Seconds from boot a new image has to get Zigbee back (joined, or factory new) before it is
        rolled back, when the image asks for the check (c6_app_verify_zigbee). The default is
        10 minutes; a rejoin after an update takes 20 s to 3 min, once 24 min.

config C6_VERIFY_BREAK_TEST
    bool "Rollback test: never count Zigbee as back"
    default n
    help
        Rollback test only: c6_base_zigbee_ready() sets nothing, so a build with this on rolls back
        after C6_VERIFY_ZIGBEE_S with Wi-Fi, HTTP and Zigbee all up. Never in a release build;
        sdkconfig.defaults keeps it off.

endmenu
```

## coord/main/Kconfig.projbuild
```kconfig
menu "c6 coord (bench Zigbee coordinator)"

config C6_ZB_CHANNEL
    int "Channel the bench network is formed on"
    range 11 26
    default 25
    help
        Not 11: clear of channel 11, where many Zigbee2MQTT and other Zigbee networks sit.

config C6_ZB_EXT_PANID
    string "Extended PAN ID (16 hex, MSB first)"
    default "0000000000000001"

config C6_ZB_REQUIRE_IC
    bool "Admit only joiners whose install code is held (the secured path of a real Zigbee controller)"
    default y

config C6_ZB_JOINER_EUI64
    string "Joiner whose install code is held (16 hex, MSB first)"
    default ""

config C6_ZB_JOINER_IC
    string "That joiner's 128-bit install code + CRC (36 hex)"
    default ""

endmenu
```

## coord/sdkconfig.defaults
```kconfig
CONFIG_IDF_TARGET="esp32c6"
CONFIG_ESPTOOLPY_FLASHSIZE_4MB=y
CONFIG_PARTITION_TABLE_CUSTOM=y
CONFIG_PARTITION_TABLE_CUSTOM_FILENAME="partitions.csv"
CONFIG_BOOTLOADER_APP_ROLLBACK_ENABLE=y
CONFIG_LOG_TIMESTAMP_SOURCE_SYSTEM=y
CONFIG_HTTPD_MAX_REQ_HDR_LEN=1024
CONFIG_ESP_MAIN_TASK_STACK_SIZE=4096
CONFIG_ESP_SYSTEM_EVENT_TASK_STACK_SIZE=4096

# Zigbee coordinator, native radio, sharing it with Wi-Fi
CONFIG_ZB_ENABLED=y
CONFIG_ZB_ZCZR=y
CONFIG_ZB_RADIO_NATIVE=y
CONFIG_ESP_COEX_SW_COEXIST_ENABLE=y

CONFIG_C6_WIFI_START_DELAY_MS=30000
```

## sniff/main/Kconfig.projbuild
```kconfig
menu "c6 sniff (receive-only 802.15.4 capture)"

config C6_SNIFF_CHANNEL
    int "Channel to listen on"
    range 11 26
    default 25
    help
        25: clear of channel 11, where many Zigbee controllers and Zigbee2MQTT networks sit. Set it to the Zigbee controller's channel.

endmenu
```
